## conf/distro/hoobian-distro.conf
```bitbake
# Distro Layer configuration
# include and overwrite default poky distro
include conf/distro/poky.conf
DISTRO = "hoobian-distro"
DISTRO_NAME = "HOO-Linux"
DISTRO_VERSION = "1.0"
DISTRO_CODENAME = "creativity"
SDK_VENDOR = "-hoosdk"
SDK_VERSION="${DISTRO_VERSION}"
MAINTAINER = "hamed.rafi@gmail.com"

TARGET_VENDOR = "-hoo"

PACKAGE_CLASSES = "package_ipk"

DISTRO_FEATURES = "\
ext2 ipv4 ipv6\
usbhost \
vfat \
rauc \
wifi \
x11 \
opengl \
pam \
"

HOOBIAN_RELEASE_VERSION = "1.0.0"
PREFERRED_VERSION_linux-raspberrypi ?= "6.1"


# Use systemd as init manager
DISTRO_FEATURES:append = " systemd"
DISTRO_FEATURES_BACKFILL_CONSIDERED += "sysvinit"
VIRTUAL-RUNTIME_init_manager = "systemd"
VIRTUAL-RUNTIME_initscripts = "systemd-compat-units"

RAUC_KEY_FILE="${COREBASE}/../meta-hoobian/recipes-core/rauc/files/ca.key.pem"
RAUC_CERT_FILE="${COREBASE}/../meta-hoobian/recipes-core/rauc/files/ca.cert.pem"

VOLATILE_LOG_DIR = "no"
```

## wic/sd-image-hoobian.wks
```
part /boot --source bootimg-partition --ondisk mmcblk0 --fstype=vfat --label boot --active --align 4096 --size 20
part / --source rawcopy --sourceparams file=rootfs-${MACHINE}.ext4 --ondisk mmcblk  --fstype=ext4 --label rootfs.0 --align 4096 --fixed-size 600
part / --source rawcopy --sourceparams file=rootfs-${MACHINE}.ext4 --ondisk mmcblk  --fstype=ext4 --label rootfs.1 --align 4096 --fixed-size 600
# part /data --source rawcopy --sourceparams file=datafs-${MACHINE}.ext4 --ondisk mmcblk --fstype=ext4 --label datafs.0 --align 4096 --fixed-size 2346
```
